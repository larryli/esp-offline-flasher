## main/Kconfig.projbuild
```kconfig
menu "Offline Flasher"

    orsource "$IDF_PATH/examples/common_components/env_caps/$IDF_TARGET/Kconfig.env_caps"

    config BOARD_BUTTON_GPIO
        int "Button GPIO number of the board"
        range ENV_GPIO_RANGE_MIN ENV_GPIO_OUT_RANGE_MAX
        default 0

    config BOARD_LED_GPIO
        int "Led GPIO number of the board"
        range ENV_GPIO_RANGE_MIN ENV_GPIO_OUT_RANGE_MAX
        default 15
    
    menu "Flash UART"

        config FLASH_UART_PORT_NUM
            int "UART port number"
            range 0 2 if IDF_TARGET_ESP32S3
            default 2 if IDF_TARGET_ESP32S3
            range 0 1
            default 1

        config FLASH_UART_RX_GPIO
            int "RX GPIO number"
            range ENV_GPIO_RANGE_MIN ENV_GPIO_OUT_RANGE_MAX
            default 16

        config FALSH_UART_TX_GPIO
            int "TX GPIO number"
            range ENV_GPIO_RANGE_MIN ENV_GPIO_OUT_RANGE_MAX
            default 18

        config FLASH_UART_RESET_GPIO
            int "Reset number"
            range ENV_GPIO_RANGE_MIN ENV_GPIO_OUT_RANGE_MAX
            default 33

        config FLASH_UART_IO0_GPIO
            int "IO0 GPIO number"
            range ENV_GPIO_RANGE_MIN ENV_GPIO_OUT_RANGE_MAX
            default 35

    endmenu

endmenu
```
